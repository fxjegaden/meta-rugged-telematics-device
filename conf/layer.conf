## conf/layer.conf
```bitbake
# We have a conf and classes directory, add to BBPATH
BBPATH .= ":${LAYERDIR}"

# We have recipes-* directories, add to BBFILES
BBFILES += "${LAYERDIR}/recipes-*/*/*.bb \
            ${LAYERDIR}/recipes-*/*/*.bbappend \
            ${LAYERDIR}/recipes-*/*/*/*.bb \
            ${LAYERDIR}/recipes-*/*/*/*.bbappend"

BBFILE_COLLECTIONS += "meta-rugged-telematics-device-source"
BBFILE_PATTERN_meta-rugged-telematics-device-source = "^${LAYERDIR}/"
BBFILE_PRIORITY_meta-rugged-telematics-device-source = "6"

LAYERDEPENDS_meta-rugged-telematics-device-source = "core"
LAYERSERIES_COMPAT_meta-rugged-telematics-device-source = "warrior zeus"

SOC_DEFAULT_IMAGE_FSTYPES_remove = " wic.gz wic.bz2 tar.bz2"
SOC_DEFAULT_IMAGE_FSTYPES_append = " ext4 tar"

#IMAGE_INSTALL_append = "u-boot-scr"
```

## conf/machine/imx6ull-iwg26i.conf
```bitbake
#@TYPE: Machine
#@NAME: Rugged Telematics Device
#@SOC: i.MX6ULL
#@DESCRIPTION: Machine configuration for Rugged Telematics Device
#@MAINTAINER: iWave Systems Technologies Pvt. Ltd. <support.obd@iwavesystems.com>

MACHINEOVERRIDES =. "mx6:mx6ul:mx6ull:"

include conf/machine/include/imx-base.inc
include conf/machine/include/tune-cortexa7.inc

MACHINE_FIRMWARE_append = " firmware-imx-epdc"

PREFERRED_PROVIDER_virtual/kernel_mx6 = "linux-imx"
PREFERRED_PROVIDER_u-boot_mx6 = "u-boot-imx"
MACHINE_EXTRA_RRECOMMENDS = " kernel-modules"
KERNEL_DEVICETREE = "imx6ull-iwg26i.dtb"

MACHINE_FEATURES_append = "bcm4339 bcm43455"

UBOOT_CONFIG ??= "sd"
UBOOT_CONFIG[sd]   = "mx6ull_iwg26i_defconfig,sdcard"

IWG26I_KERNEL_DEFCONFIG = "imx6ull_iwg26i_defconfig"
KERNEL_IMAGETYPE_imx6ull-iwg26i = "zImage"

OPTEE_BIN_EXT = "6ull-iwg26i"

EXTRA_IMAGE_FEATURES += "ssh-server-openssh"
PACKAGECONFIG_remove += "packagegroup-core-ssh-dropbear dropbear"
IMAGE_INSTALL_remove += "packagegroup-core-ssh-dropbear dropbear"

# For initramfs
IMAGE_INSTALL_append += " \
	dhcpcd keyutils lvm2 e2fsprogs-mke2fs \
"
```
